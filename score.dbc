BO_ 500 MY_MESSAGE: 4 MY_ECU
 SG_ scaled_scores_average : 0|32@1+ (1,0) [0|100] "%"  SOME_ECU
